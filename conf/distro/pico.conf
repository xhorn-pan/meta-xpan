## conf/distro/pico.conf
```bitbake
DISTRO = "pico"
DISTRO_VERSION = "0.0.1"
DISTRO_CODENAME = "kirkstone"
SDK_VENDOR = "-picosdk"
SDK_VERSION = "${@d.getVar('DISTRO_VERSION').replace('snapshot-${METADATA_REVISION}', 'snapshot')}"
SDK_VERSION[vardepvalue] = "${SDK_VERSION}"

POKY_DEFAULT_DISTRO_FEATURES = "pci opengl ipv4 usbhost"
POKY_DEFAULT_EXTRA_RDEPENDS = "packagegroup-core-boot"
POKY_DEFAULT_EXTRA_RRECOMMENDS = "kernel-module-af-packet"

FULL_OPTIMIZATION="-Os -pipe ${DEBUG_FLAGS}"

DISTRO_FEATURES ?= "${DISTRO_FEATURES_DEFAULT} ${POKY_DEFAULT_DISTRO_FEATURES}"

PREFERRED_PROVIDER_virtual/kernel = "linux-intel-rt"
PREFERRED_VERSION_linux-intel ?= "5.10%"
PREFERRED_VERSION_linux-intel-rt ?= "5.10%"

SDK_NAME = "${DISTRO}-${TCLIBC}-${SDKMACHINE}-${IMAGE_BASENAME}-${TUNE_PKGARCH}-${MACHINE}"
SDKPATHINSTALL = "/opt/${DISTRO}/${SDK_VERSION}"

DISTRO_EXTRA_RDEPENDS += "${POKY_DEFAULT_EXTRA_RDEPENDS}"
DISTRO_EXTRA_RRECOMMENDS += "${POKY_DEFAULT_EXTRA_RRECOMMENDS}"

# add poky sanity bbclass
INHERIT += "poky-sanity"

BB_SIGNATURE_HANDLER ?= "OEEquivHash"
BB_HASHSERVE ??= "auto"

IMAGE_LINGUAS = "en_US zh_CN"
```

## conf/layer.conf
```bitbake
# We have a conf and classes directory, add to BBPATH
BBPATH .= ":${LAYERDIR}"

# We have recipes-* directories, add to BBFILES
BBFILES += "${LAYERDIR}/recipes-*/*/*.bb \
            ${LAYERDIR}/recipes-*/*/*.bbappend"
BBLAYERS += "${LAYERDIR}/../meta-intel"
BBFILE_COLLECTIONS += "meta-xpan"
BBFILE_PATTERN_meta-xpan = "^${LAYERDIR}/"
BBFILE_PRIORITY_meta-xpan = "8"

LAYERDEPENDS_meta-xpan = "intel"
LAYERSERIES_COMPAT_meta-xpan = "kirkstone"
```

## conf/machine/atom-64.conf
```bitbake
DEFAULTTUNE ?= "core2-64"
require conf/machine/include/meta-intel.inc
require conf/machine/include/intel-common-pkgarch.inc
require conf/machine/include/x86/tune-core2.inc
require conf/machine/include/x86/x86-base.inc

MACHINE_FEATURES:remove = " ext2 ext3 usbgadget"
MACHINE_FEATURES += " intel-ucode ext4"
KMACHINE_atom-64 = "linux-intel"
```
